## projects/swiot1l/Kconfig
```kconfig
menu "SWIOT1L Configuration"

choice SWIOT1L_FW_VARIANT
	prompt "Firmware variant"
	default SWIOT1L_DEFAULT_FW

config SWIOT1L_DEFAULT_FW
	bool "Default IIO firmware"
	help
	  Build the default IIO-based firmware with two-stage
	  CONFIG/RUNTIME boot and channel configuration support.

config SWIOT1L_MQTT_EXAMPLE
	bool "MQTT example"
	help
	  Build the MQTT example firmware that publishes
	  AD74413R sensor data to an MQTT broker.

config SWIOT1L_MOTOR_CONTROL
	bool "Motor control firmware"
	help
	  Build a minimal firmware that outputs a 10 kHz software
	  PWM on P1.28 (PMOD pin 4) and accepts SET_PWM/GET_PWM/STOP
	  text commands over TCP. Used to drive a DRV8874 H-bridge
	  motor driver. Does not initialize MAX14906, AD74413R, or
	  ADT75.

endchoice

config SWIOT1L_MQTT_SERVER_IP
	string "MQTT broker IP address"
	default "192.168.97.1"
	depends on SWIOT1L_MQTT_EXAMPLE

config SWIOT1L_MQTT_SERVER_PORT
	int "MQTT broker port"
	default 1883
	depends on SWIOT1L_MQTT_EXAMPLE

config SWIOT1L_STATIC_IP
	bool "Use static IP address"
	default n
	select NO_OS_STATIC_IP
	help
	  Use a static IP instead of DHCP.

config SWIOT1L_OA_TC6_SPI
	bool "Use OA TC6 SPI protocol"
	default n

endmenu
```
